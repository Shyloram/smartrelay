## main/Kconfig.projbuild
```kconfig
menu "Example Configuration"

config SOFTAP_SSID
    string "WiFi SSID"
    default "worktest"
    help
    SSID (network name) for the example to connect to.

config SOFTAP_PASS
    string "WiFi Password"
    default "12345678"
    help
    WiFi password (WPA or WPA2) for the example to use.

config RESET_PROVISIONED
    bool
    default n
    prompt "Reset provisioned status of the device"
    help
    This erases the NVS to reset provisioned status of the device on every reboot.
    Provisioned status is determined by the WiFi STA configuration, saved on the NVS.

config EXAMPLE_PORT
    int "Port"
    range 0 65535
    default 3333
    help
        Local port the example server will listen on.

endmenu
```
